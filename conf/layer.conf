## conf/layer.conf
```bitbake
# We have a conf and classes directory, add to BBPATH
BBPATH .= ":${LAYERDIR}"

# We have recipes-* directories, add to BBFILES
BBFILES += "${LAYERDIR}/recipes-*/*.bb \
            ${LAYERDIR}/recipes-*/*.bbappend"

BBFILE_COLLECTIONS += "meta-tailscale"
BBFILE_PATTERN_meta-tailscale = "^${LAYERDIR}/"
BBFILE_PRIORITY_meta-tailscale = "6"

LAYERDEPENDS_meta-tailscale = "core"
LAYERSERIES_COMPAT_meta-tailscale = "scarthgap nanbield kirkstone"
```
